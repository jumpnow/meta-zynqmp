## conf/bblayers.conf.sample
```bitbake
# POKY_BBLAYERS_CONF_VERSION is increased each time build/conf/bblayers.conf
# changes incompatibly
POKY_BBLAYERS_CONF_VERSION = "2"

BBPATH = "${TOPDIR}"
BBFILES ?= ""

BBLAYERS ?= " \
  ${HOME}/poky-warrior/meta \
  ${HOME}/poky-warrior/meta-poky \
  ${HOME}/poky-warrior/meta-openembedded/meta-oe \
  ${HOME}/poky-warrior/meta-openembedded/meta-networking \
  ${HOME}/poky-warrior/meta-openembedded/meta-perl \
  ${HOME}/poky-warrior/meta-openembedded/meta-python \
  ${HOME}/poky-warrior/meta-security \
  ${HOME}/poky-warrior/xilinx/meta-xilinx/meta-xilinx-bsp \
  ${HOME}/poky-warrior/xilinx/meta-xilinx/meta-xilinx-standalone \
  ${HOME}/meta-zynqmp \
"
```

## conf/layer.conf
```bitbake
# We have a conf and classes directory, append to BBPATH
BBPATH .= ":${LAYERDIR}"

# We have a recipes directory, add to BBFILES
BBFILES += "${LAYERDIR}/recipes*/*/*.bb ${LAYERDIR}/recipes*/*/*.bbappend ${LAYERDIR}/images/*.bb"

BBFILE_COLLECTIONS += "meta-zynqmp"
BBFILE_PATTERN_meta-zynqmp := "^${LAYERDIR}/"
BBFILE_PRIORITY_meta-zynqmp = "16"

LAYERSERIES_COMPAT_meta-zynqmp = "honister"
```

## conf/local.conf.sample
```bitbake
# Local configuration for meta-zynqmp images
# Only tested with zcu102-zynqmp dev boards
# Yocto Project 4.0 Poky distribution [kirkstone] branch

LICENSE_FLAGS_ACCEPTED += "xilinx"

DISTRO_FEATURES = "ext2 security systemd usbhost ${DISTRO_FEATURES_LIBC}"

DISTRO_FEATURES_BACKFILL_CONSIDERED += "pulseaudio sysvinit"

DISTRO_FEATURES:remove = "ptest"

INIT_MANAGER = "systemd"

MACHINE = "zcu102-zynqmp"

PREFERRED_PROVIDER_virtual/kernel = "linux-stable"

# linux-stable_5.17 is available 
PREFERRED_VERSION_linux-stable = "5.15.%"

# DL_DIR = "/oe/dl/kirkstone"
# SSTATE_DIR = "/oe/zynqmp/sstate-cache"
# TMPDIR = "/oe/zynqmp/tmp"

DISTRO = "poky"
PACKAGE_CLASSES = "package_ipk"

SDKMACHINE = "x86_64"

EXTRA_IMAGE_FEATURES = "debug-tweaks"

PATCHRESOLVE = "noop"
RM_OLD_IMAGE = "1"
INHERIT += "rm_work"
CONF_VERSION = "2"
```

## conf/machine/db-zynqmp.conf
```bitbake
#@TYPE: Machine
#@NAME: db-zynqmp
#@DESCRIPTION: Machine support for a zcu102 dev board (db)
#
# A build test faking a new machine with a custom xsa though in reality it is the
# same zcu102 xsa that the extended-hdf recipe pulls from the hdf-examples repo. 
#

SOC_FAMILY = "zynqmp"
SOC_VARIANT = "eg"

require conf/machine/include/tune-zynqmp.inc
require conf/machine/include/machine-xilinx-overrides.inc
require conf/machine/include/machine-xilinx-default.inc

PREFERRED_PROVIDER_virtual/kernel = "linux-dev"
PREFERRED_PROVIDER_virtual/bootloader = "u-boot-xlnx"
PREFERRED_PROVIDER_virtual/boot-bin = "xilinx-bootbin"

UBOOT_MACHINE = "xilinx_zynqmp_virt_defconfig"

SERIAL_CONSOLES = "115200;ttyPS0"

EXTRA_IMAGEDEPENDS += " \
    arm-trusted-firmware \
    u-boot-zynq-scr \
    virtual/boot-bin \
    virtual/bootloader \
"

IMAGE_BOOT_FILES += " \
    uEnv.txt \
    atf-uboot.ub \
"

MACHINE_ESSENTIAL_EXTRA_RDEPENDS = "kernel-image kernel-devicetree"

MACHINE_FEATURES = "ext2 ext3 vfat usbhost wifi"
```

## conf/machine/ultra96-zynqmp.conf
```bitbake
#@TYPE: Machine
#@NAME: ultra96-zynqmp
#@DESCRIPTION: Machine support for Ultra96v2 Evaluation Board.

SOC_FAMILY = "zynqmp"
SOC_VARIANT = "eg"

require conf/machine/include/tune-zynqmp.inc
require conf/machine/include/machine-xilinx-overrides.inc
require conf/machine/include/machine-xilinx-default.inc

ULTRA96_VERSION = "2"

PREFERRED_PROVIDER_virtual/kernel = "linux-dev"
PREFERRED_PROVIDER_virtual/bootloader = "u-boot-xlnx"
PREFERRED_PROVIDER_virtual/boot-bin = "xilinx-bootbin"

UBOOT_MACHINE = "xilinx_zynqmp_virt_defconfig"

SERIAL_CONSOLES = "115200;ttyPS0"

EXTRA_IMAGEDEPENDS += " \
    arm-trusted-firmware \
    u-boot-zynq-scr \
    virtual/boot-bin \
    virtual/bootloader \
"

IMAGE_BOOT_FILES += " \
    uEnv.txt \
    atf-uboot.ub \
"

MACHINE_ESSENTIAL_EXTRA_RDEPENDS = "kernel-image kernel-devicetree"

MACHINE_FEATURES = "ext2 ext3 vfat usbhost wifi"
```

## conf/machine/zcu102-zynqmp.conf
```bitbake
#@TYPE: Machine
#@NAME: zcu102-zynqmp
#@DESCRIPTION: Machine configuration for the Xilinx zcu102 zynqmp dev board

TARGET_ARCH = "aarch64"

DEFAULTTUNE = "cortexa72-cortexa53"

require conf/machine/include/arm/armv8a/tune-cortexa72-cortexa53.inc

PREFERRED_PROVIDER_virtual/kernel ?= "linux-stable"

PREFERRED_PROVIDER_virtual/bootloader ?= "u-boot"

UBOOT_MACHINE ?= "xilinx_zynqmp_virt_defconfig"

EXTRA_IMAGEDEPENDS += "arm-trusted-firmware u-boot u-boot-scr"

SERIAL_CONSOLES = "115200;ttyPS0"

IMAGE_FSTYPES ?= "tar.gz"

KERNEL_IMAGETYPE ?= "Image"

MACHINE_ESSENTIAL_EXTRA_RDEPENDS = "kernel-image kernel-devicetree"

MACHINE_FEATURES = "ext2 serial usbhost vfat"
```

## conf/machine/zcu102x-zynqmp.conf
```bitbake
#@TYPE: Machine
#@NAME: zcu102x-zynqmp
#@DESCRIPTION: Alternative machine support for zcu102 board

SOC_FAMILY = "zynqmp"
SOC_VARIANT = "eg"

require conf/machine/include/tune-zynqmp.inc
require conf/machine/include/machine-xilinx-overrides.inc
require conf/machine/include/machine-xilinx-default.inc

PREFERRED_PROVIDER_virtual/kernel = "linux-xlnx"
PREFERRED_PROVIDER_virtual/bootloader = "u-boot-xlnx"
PREFERRED_PROVIDER_virtual/boot-bin = "xilinx-bootbin"

UBOOT_MACHINE = "zynqmp_zcu102x_defconfig"

KERNEL_DEVICETREE = "xilinx/zynqmp-zcu102-rev1.0.dtb"

SERIAL_CONSOLES = "115200;ttyPS0"

EXTRA_IMAGEDEPENDS += " \
    arm-trusted-firmware \
    u-boot-zynq-scr \
    virtual/boot-bin \
    virtual/bootloader \
"

IMAGE_BOOT_FILES += " \
    uEnv.txt \
    atf-uboot.ub \
"

MACHINE_ESSENTIAL_EXTRA_RDEPENDS = "kernel-image kernel-devicetree"

MACHINE_FEATURES = "ext2 ext3 vfat usbhost wifi"
```
